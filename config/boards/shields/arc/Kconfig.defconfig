## config/boards/shields/arc/Kconfig.defconfig
```kconfig
if SHIELD_ARC_LEFT

config ZMK_KEYBOARD_NAME
    default "arc"

config ZMK_SPLIT_ROLE_CENTRAL
    default y

endif

if SHIELD_ARC_LEFT || SHIELD_ARC_RIGHT

config ZMK_SPLIT
    default y

endif
```

## config/boards/shields/galaga/Kconfig.defconfig
```kconfig
if SHIELD_GALAGA_LEFT

config ZMK_KEYBOARD_NAME
    default "galaga"

config ZMK_SPLIT_ROLE_CENTRAL
    default y

endif

if SHIELD_GALAGA_LEFT || SHIELD_GALAGA_RIGHT

config ZMK_SPLIT
    default y

endif
```

## config/boards/shields/galaga/Kconfig.shield
```kconfig
config SHIELD_GALAGA_LEFT
    def_bool $(shields_list_contains,galaga_left)
config SHIELD_GALAGA_RIGHT
    def_bool $(shields_list_contains,galaga_right)
```
