#include "arc.dtsi"

&kscan0 {
    col-gpios
        = <&pro_micro 3 GPIO_ACTIVE_HIGH> // col1 in the schematic
        , <&pro_micro 4 GPIO_ACTIVE_HIGH> // col2 in the schematic
        , <&pro_micro 14 GPIO_ACTIVE_HIGH> // col3 in the schematic
        , <&pro_micro 15 GPIO_ACTIVE_HIGH> // col4 in the schematic
        , <&pro_micro 20 GPIO_ACTIVE_HIGH> // col5 in the schematic
        ;
};
